VERSION "vehicular_ids_demo"

NS_ :

BS_:

BU_: VCU ABS BCM IC GW

BO_ 256 VEH_SPEED_STATUS: 8 VCU
 SG_ vehicle_speed : 0|16@0+ (0.01,0) [0|655.35] "km/h" IC
 SG_ engine_rpm : 16|16@0+ (1,0) [0|65535] "rpm" IC
 SG_ throttle_pct : 32|8@0+ (1,0) [0|100] "%" IC
 SG_ brake_flag : 40|8@0+ (1,0) [0|1] "" IC
 SG_ coolant_temp : 48|8@0+ (1,-40) [-40|215] "C" IC
 SG_ rolling_counter : 56|8@0+ (1,0) [0|255] "" IC

BO_ 257 WHEEL_SPEED_FRONT: 8 ABS
 SG_ vehicle_speed : 0|16@0+ (0.01,0) [0|655.35] "km/h" IC
 SG_ engine_rpm : 16|16@0+ (1,0) [0|65535] "rpm" IC
 SG_ throttle_pct : 32|8@0+ (1,0) [0|100] "%" IC
 SG_ brake_flag : 40|8@0+ (1,0) [0|1] "" IC
 SG_ coolant_temp : 48|8@0+ (1,-40) [-40|215] "C" IC
 SG_ rolling_counter : 56|8@0+ (1,0) [0|255] "" IC

BO_ 258 WHEEL_SPEED_REAR: 8 ABS
 SG_ vehicle_speed : 0|16@0+ (0.01,0) [0|655.35] "km/h" IC
 SG_ engine_rpm : 16|16@0+ (1,0) [0|65535] "rpm" IC
 SG_ throttle_pct : 32|8@0+ (1,0) [0|100] "%" IC
 SG_ brake_flag : 40|8@0+ (1,0) [0|1] "" IC
 SG_ coolant_temp : 48|8@0+ (1,-40) [-40|215] "C" IC
 SG_ rolling_counter : 56|8@0+ (1,0) [0|255] "" IC

BO_ 512 BODY_STATUS: 8 BCM
 SG_ vehicle_speed : 0|16@0+ (0.01,0) [0|655.35] "km/h" IC
 SG_ engine_rpm : 16|16@0+ (1,0) [0|65535] "rpm" IC
 SG_ throttle_pct : 32|8@0+ (1,0) [0|100] "%" IC
 SG_ brake_flag : 40|8@0+ (1,0) [0|1] "" IC
 SG_ coolant_temp : 48|8@0+ (1,-40) [-40|215] "C" IC
 SG_ rolling_counter : 56|8@0+ (1,0) [0|255] "" IC

BO_ 513 POWERTRAIN_STATUS: 8 VCU
 SG_ vehicle_speed : 0|16@0+ (0.01,0) [0|655.35] "km/h" IC
 SG_ engine_rpm : 16|16@0+ (1,0) [0|65535] "rpm" IC
 SG_ throttle_pct : 32|8@0+ (1,0) [0|100] "%" IC
 SG_ brake_flag : 40|8@0+ (1,0) [0|1] "" IC
 SG_ coolant_temp : 48|8@0+ (1,0) [0|255] "C" IC
 SG_ rolling_counter : 56|8@0+ (1,0) [0|255] "" IC

BO_ 768 DIAGNOSTIC_STATUS: 8 GW
 SG_ vehicle_speed : 0|16@0+ (0.01,0) [0|655.35] "km/h" IC
 SG_ engine_rpm : 16|16@0+ (1,0) [0|65535] "rpm" IC
 SG_ throttle_pct : 32|8@0+ (1,0) [0|100] "%" IC
 SG_ brake_flag : 40|8@0+ (1,0) [0|1] "" IC
 SG_ coolant_temp : 48|8@0+ (1,0) [0|255] "C" IC
 SG_ rolling_counter : 56|8@0+ (1,0) [0|255] "" IC

BO_ 769 CLUSTER_STATUS: 8 IC
 SG_ vehicle_speed : 0|16@0+ (0.01,0) [0|655.35] "km/h" IC
 SG_ engine_rpm : 16|16@0+ (1,0) [0|65535] "rpm" IC
 SG_ throttle_pct : 32|8@0+ (1,0) [0|100] "%" IC
 SG_ brake_flag : 40|8@0+ (1,0) [0|1] "" IC
 SG_ coolant_temp : 48|8@0+ (1,0) [0|255] "C" IC
 SG_ rolling_counter : 56|8@0+ (1,0) [0|255] "" IC
